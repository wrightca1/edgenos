## config/kernel/as5610_defconfig
```kconfig
# EdgeNOS kernel config for Edgecore AS5610-52X
# Platform: Freescale P2020 (e500v2, MPC85xx family)

# ── Architecture ──────────────────────────────────────────────────
CONFIG_PPC=y
CONFIG_PPC32=y
CONFIG_PPC_85xx=y
CONFIG_MPC85xx_RDB=y
CONFIG_E500=y
CONFIG_SWIOTLB=y
CONFIG_SPE=y
CONFIG_MATH_EMULATION=y
CONFIG_MATH_EMULATION_FULL=y
CONFIG_PPC_EMULATED_STATS=y
CONFIG_PPC_E500MC=n
CONFIG_PHYS_64BIT=n
CONFIG_RELOCATABLE=y
CONFIG_ADVANCED_OPTIONS=y
CONFIG_FSL_SOC=y
CONFIG_FSL_PCI=y
CONFIG_FSL_LBC=y
CONFIG_FSL_IFC=n
CONFIG_FSL_GTM=y

# ── General setup ─────────────────────────────────────────────────
CONFIG_LOCALVERSION="-edgenos"
CONFIG_SYSVIPC=y
CONFIG_POSIX_MQUEUE=y
CONFIG_CGROUPS=y
CONFIG_NAMESPACES=y
CONFIG_BLK_DEV_INITRD=y
CONFIG_INITRAMFS_SOURCE=""
CONFIG_EXPERT=y
CONFIG_SYSFS_DEPRECATED=n
CONFIG_KALLSYMS=y
CONFIG_PRINTK=y
CONFIG_BUG=y
CONFIG_EMBEDDED=y
CONFIG_MODULES=y
CONFIG_MODULE_UNLOAD=y
CONFIG_MODVERSIONS=y

# ── Processor features ───────────────────────────────────────────
CONFIG_NR_CPUS=2
CONFIG_SMP=y
CONFIG_HZ_1000=y

# ── Memory ────────────────────────────────────────────────────────
CONFIG_HIGHMEM=y
CONFIG_FLATMEM=y
CONFIG_LOWMEM_SIZE_BOOL=n

# ── Bus ───────────────────────────────────────────────────────────
CONFIG_PCI=y
CONFIG_PCI_MSI=y

# ── Networking ────────────────────────────────────────────────────
CONFIG_NET=y
CONFIG_PACKET=y
CONFIG_UNIX=y
CONFIG_INET=y
CONFIG_IP_MULTICAST=y
CONFIG_IP_ADVANCED_ROUTER=y
CONFIG_IP_MULTIPLE_TABLES=y
CONFIG_IP_ROUTE_MULTIPATH=y
CONFIG_IP_PNP=y
CONFIG_IP_PNP_DHCP=y
CONFIG_NET_IPIP=m
CONFIG_NET_IPGRE_DEMUX=m
CONFIG_NET_IPGRE=m
CONFIG_SYN_COOKIES=y
CONFIG_IPV6=y
CONFIG_IPV6_MULTIPLE_TABLES=y
CONFIG_IPV6_ROUTE_INFO=y
CONFIG_BRIDGE=m
CONFIG_VLAN_8021Q=m
CONFIG_BONDING=m
CONFIG_TUN=y
CONFIG_NETFILTER=y
CONFIG_NETLINK_DIAG=y
CONFIG_NF_CONNTRACK=m
CONFIG_NETFILTER_XTABLES=m
CONFIG_NF_TABLES=m

# ── Device drivers ────────────────────────────────────────────────

# Serial / console
CONFIG_SERIAL_8250=y
CONFIG_SERIAL_8250_CONSOLE=y
CONFIG_SERIAL_8250_NR_UARTS=2
CONFIG_SERIAL_8250_RUNTIME_UARTS=2
CONFIG_SERIAL_8250_FSL=y
CONFIG_SERIAL_8250_EXTENDED=y
CONFIG_SERIAL_8250_SHARE_IRQ=y
CONFIG_SERIAL_EARLYCON=y
CONFIG_SERIAL_OF_PLATFORM=n
CONFIG_PPC_UDBG_16550=y
CONFIG_EARLY_PRINTK=y
CONFIG_VT=n

# Ethernet (management port - Freescale eTSEC / gianfar)
CONFIG_NETDEVICES=y
CONFIG_ETHERNET=y
CONFIG_NET_VENDOR_FREESCALE=y
CONFIG_GIANFAR=y
CONFIG_PHYLIB=y
CONFIG_MDIO_BUS=y
CONFIG_MDIO_DEVICE=y
CONFIG_OF_MDIO=y
CONFIG_FSL_PQ_MDIO=y
CONFIG_BROADCOM_PHY=y
CONFIG_FIXED_PHY=y
CONFIG_HAS_DMA=y

# I2C
CONFIG_I2C=y
CONFIG_I2C_CHARDEV=y
CONFIG_I2C_MPC=y
CONFIG_I2C_MUX=y
CONFIG_I2C_MUX_PCA954x=y

# GPIO
CONFIG_GPIOLIB=y
CONFIG_GPIO_SYSFS=y
CONFIG_GPIO_PCA953X=y
CONFIG_GPIO_PCA953X_IRQ=n

# Sensors / HWMON
CONFIG_HWMON=y
CONFIG_SENSORS_MAX6697=y
CONFIG_SENSORS_ADM1021=y
CONFIG_SENSORS_LM75=y

# EEPROM
CONFIG_EEPROM_AT24=y
CONFIG_EEPROM_AT25=m

# SPI
CONFIG_SPI=y
CONFIG_SPI_FSL_SPI=y
CONFIG_SPI_FSL_ESPI=y

# Watchdog
CONFIG_WATCHDOG=y

# SCSI subsystem (required for USB_STORAGE → /dev/sdX)
CONFIG_SCSI=y
CONFIG_BLK_DEV_SD=y
CONFIG_SCSI_MOD=y

# USB (internal USB flash)
CONFIG_USB=y
CONFIG_USB_EHCI_HCD=y
CONFIG_USB_EHCI_FSL=y
CONFIG_USB_EHCI_ROOT_HUB_TT=y
CONFIG_USB_STORAGE=y

# Partition table support (required for /dev/sda5, /dev/sda6)
CONFIG_MSDOS_PARTITION=y
CONFIG_PARTITION_ADVANCED=y
CONFIG_BLK_DEV_LOOP=y

# Filesystems
CONFIG_EXT4_FS=y
CONFIG_SQUASHFS=y
CONFIG_SQUASHFS_XZ=y
CONFIG_SQUASHFS_ZSTD=y
CONFIG_TMPFS=y
CONFIG_PROC_FS=y
CONFIG_SYSFS=y
CONFIG_DEVTMPFS=y
CONFIG_DEVTMPFS_MOUNT=y
CONFIG_OVERLAY_FS=y
CONFIG_VFAT_FS=y
CONFIG_FAT_FS=y
CONFIG_NLS_CODEPAGE_437=y
CONFIG_NLS_ISO8859_1=y

# MTD (NOR flash)
CONFIG_MTD=y
CONFIG_MTD_CFI=y
CONFIG_MTD_CFI_AMDSTD=y
CONFIG_MTD_OF_PARTS=y
CONFIG_MTD_PHYSMAP_OF=y

# RTC (AS5610 has RTC8564 which is PCF8563 compatible)
CONFIG_RTC_CLASS=y
CONFIG_RTC_DRV_PCF8563=y
CONFIG_RTC_DRV_DS1307=y

# LED
CONFIG_NEW_LEDS=y
CONFIG_LEDS_CLASS=y
CONFIG_LEDS_GPIO=y

# ── Kernel features ──────────────────────────────────────────────
CONFIG_PREEMPT_VOLUNTARY=y
CONFIG_COMPAT_BRK=y
CONFIG_SLAB=y
CONFIG_PROFILING=n

# ── Boot ──────────────────────────────────────────────────────────
CONFIG_CMDLINE_BOOL=n

# ── Debugging (minimal for production) ───────────────────────────
CONFIG_PRINTK_TIME=y
CONFIG_MAGIC_SYSRQ=y
CONFIG_DEBUG_FS=y
CONFIG_DEBUG_KERNEL=n
```

## config/rootfs/buildroot_defconfig
```kconfig
# EdgeNOS Buildroot configuration for AS5610-52X
# Target: PowerPC e500v2 (P2020)

# Architecture
BR2_powerpc=y
BR2_powerpc_e500v2=y

# Toolchain - use Buildroot's internal toolchain (avoids distro toolchain issues)
BR2_TOOLCHAIN_BUILDROOT=y
BR2_TOOLCHAIN_BUILDROOT_GLIBC=y
BR2_GCC_VERSION_12_X=y
BR2_TOOLCHAIN_BUILDROOT_CXX=y

# System
BR2_TARGET_GENERIC_HOSTNAME="edgenos"
BR2_TARGET_GENERIC_ISSUE="EdgeNOS for AS5610-52X"
BR2_TARGET_GENERIC_GETTY_PORT="ttyS0"
BR2_TARGET_GENERIC_GETTY_BAUDRATE_115200=y
BR2_ROOTFS_OVERLAY="/build/config/rootfs/overlay"
BR2_INIT_SYSTEMD=y
BR2_ROOTFS_POST_BUILD_SCRIPT="/build/config/rootfs/post-build.sh"

# Filesystem
BR2_TARGET_ROOTFS_SQUASHFS=y
BR2_TARGET_ROOTFS_SQUASHFS4_XZ=y
BR2_TARGET_ROOTFS_TAR=y

# Don't build kernel (we build separately)
BR2_LINUX_KERNEL=n

# Core packages
BR2_PACKAGE_BUSYBOX=y
BR2_PACKAGE_COREUTILS=y
BR2_PACKAGE_BASH=y
BR2_PACKAGE_PROCPS_NG=y
BR2_PACKAGE_UTIL_LINUX=y
BR2_PACKAGE_KMOD=y

# Networking
BR2_PACKAGE_IPROUTE2=y
BR2_PACKAGE_IPTABLES=y
BR2_PACKAGE_BRIDGE_UTILS=y
BR2_PACKAGE_ETHTOOL=y
BR2_PACKAGE_OPENSSH=y
BR2_PACKAGE_DROPBEAR=n
BR2_PACKAGE_TCPDUMP=y
BR2_PACKAGE_WGET=y
BR2_PACKAGE_LIBCURL=y
BR2_PACKAGE_LIBCURL_CURL=y
BR2_PACKAGE_NTP=y

# I2C / Hardware tools
BR2_PACKAGE_I2C_TOOLS=y
BR2_PACKAGE_LMSENSORS=y
BR2_PACKAGE_PCIUTILS=y
BR2_PACKAGE_USBUTILS=y

# Python (for management scripts)
BR2_PACKAGE_PYTHON3=y
BR2_PACKAGE_PYTHON3_READLINE=y

# System utilities
BR2_PACKAGE_RSYNC=y
BR2_PACKAGE_NANO=y
BR2_PACKAGE_LESS=y
BR2_PACKAGE_FILE=y
BR2_PACKAGE_STRACE=y
BR2_PACKAGE_LSOF=y
BR2_PACKAGE_HTOP=y
BR2_PACKAGE_EUDEV=y

# U-Boot tools (for fw_setenv)
BR2_PACKAGE_UBOOT_TOOLS=y
BR2_PACKAGE_UBOOT_TOOLS_FWPRINTENV=y

# Logging
BR2_PACKAGE_LOGROTATE=y
```
